# ATmega324PB register map
Vendor: Atmel; File version: 1.0
CPU: other r0p0, little endian, no MPU, no FPU, 4 interrupt priority bits
Registers are 8-bit, read-write, reset 0x0 unless marked. A register's access mark holds for its fields unless they carry their own. Offsets are from the block's base; lines under a group give offsets from that group; [hi:lo] are bit positions; {n}, {i} and the like mark numbered series; 'fields as' and 'values as' point back to an identical list; <NAME> marks a mode.

## Memory map
0x00000000 FUSE size 0x3 — Fuses
0x00000000 LOCKBIT size 0x1 — Lockbits
0x00000020 PORTA size 0x3 — I/O Port
0x00000023 PORTB size 0x3 — I/O Port
0x00000026 PORTC size 0x3 — I/O Port
0x00000029 PORTD size 0x3 — I/O Port
0x0000002C PORTE size 0x3 — I/O Port
0x00000035 TC0 blocks up to offset 0x3A — Timer/Counter, 8-bit
0x00000036 TC1 blocks up to offset 0x56 — Timer/Counter, 16-bit
0x00000037 TC2 blocks up to offset 0x80 — Timer/Counter, 8-bit Async
0x00000038 TC3 blocks up to offset 0x64 — Timer/Counter, 16-bit
0x00000039 TC4 blocks up to offset 0x73 — Timer/Counter, 16-bit
0x0000003B EXINT blocks up to offset 0x3B — External Interrupts
0x0000003E CPU blocks up to offset 0x29 — CPU Registers
0x0000003F EEPROM size 0x4
0x0000004C SPI0 size 0x3 — Serial Peripheral Interface
0x0000004F AC blocks up to offset 0x31 — Analog Comparator
0x00000051 JTAG blocks up to offset 0x5 — JTAG Interface
0x00000060 WDT size 0x1 — Watchdog Timer
0x00000062 CFD size 0x1 — Clock Failure Detection
0x00000078 ADC blocks up to offset 0x7 — Analog-to-Digital Converter
0x000000AC SPI1 size 0x3 — Serial Peripheral Interface
0x000000B8 TWI0 size 0x6 — Two Wire Serial Interface
0x000000C0 USART0 size 0x7 — USART
0x000000C8 USART1 size 0x7 — USART
0x000000D0 USART2 size 0x7 — USART
0x000000D8 TWI1 size 0x6 — Two Wire Serial Interface

## Interrupts
0 RESET (CPU) — External Pin,Power-on Reset,Brown-out Reset,Watchdog Reset,and JTAG AVR Reset. See Datasheet.
1 INT0 (CPU) — External Interrupt Request 0
2 INT1 (CPU) — External Interrupt Request 1
3 INT2 (CPU) — External Interrupt Request 2
4 PCINT0 (CPU) — Pin Change Interrupt Request 0
5 PCINT1 (CPU) — Pin Change Interrupt Request 1
6 PCINT2 (CPU) — Pin Change Interrupt Request 2
7 PCINT3 (CPU) — Pin Change Interrupt Request 3
8 WDT (CPU) — Watchdog Time-out Interrupt
9 TIMER2_COMPA (CPU) — Timer/Counter2 Compare Match A
10 TIMER2_COMPB (CPU) — Timer/Counter2 Compare Match B
11 TIMER2_OVF (CPU) — Timer/Counter2 Overflow
12 TIMER1_CAPT (CPU) — Timer/Counter1 Capture Event
13 TIMER1_COMPA (CPU) — Timer/Counter1 Compare Match A
14 TIMER1_COMPB (CPU) — Timer/Counter1 Compare Match B
15 TIMER1_OVF (CPU) — Timer/Counter1 Overflow
16 TIMER0_COMPA (CPU) — Timer/Counter0 Compare Match A
17 TIMER0_COMPB (CPU) — Timer/Counter0 Compare Match B
18 TIMER0_OVF (CPU) — Timer/Counter0 Overflow
19 SPI0_STC (CPU) — SPI0 Serial Transfer Complete
20 USART0_RX (CPU) — USART0 Rx Complete
21 USART0_UDRE (CPU) — USART0 Data register Empty
22 USART0_TX (CPU) — USART0 Tx Complete
23 ANALOG_COMP (CPU) — Analog Comparator
24 ADC (CPU) — ADC Conversion Complete
25 EE_READY (CPU) — EEPROM Ready
26 TWI0 (CPU) — 2-wire Serial Interface 0
27 SPM_READY (CPU) — Store Program Memory Read
28 USART1_RX (CPU) — USART1 RX complete
29 USART1_UDRE (CPU) — USART1 Data Register Empty
30 USART1_TX (CPU) — USART1 TX complete
31 TIMER3_CAPT (CPU) — Timer/Counter3 Capture Event
32 TIMER3_COMPA (CPU) — Timer/Counter3 Compare Match A
33 TIMER3_COMPB (CPU) — Timer/Counter3 Compare Match B
34 TIMER3_OVF (CPU) — Timer/Counter3 Overflow
35 USART0_RXS_START (CPU) — USART0 RX start edge detect
36 USART1_RXS_START (CPU) — USART1 RX start edge detect
37 PCINT4 (CPU) — Pin Change Interrupt Request 4
38 XOSCFD (CPU) — Crystal failure detect
39 PTC_EOC (CPU) — PTC end of conversion
40 PTC_WCOMP (CPU) — PTC window comparator interrupt
41 SPI1_STC (CPU) — SPI1 Serial Transfer Complete
42 TWI1 (CPU) — 2-wire Serial Interface 1
43 TIMER4_CAPT (CPU) — Timer/Counter4 Capture Event
44 TIMER4_COMPA (CPU) — Timer/Counter4 Compare Match A
45 TIMER4_COMPB (CPU) — Timer/Counter4 Compare Match B
46 TIMER4_OVF (CPU) — Timer/Counter4 Overflow
47 USART2_RX (CPU) — USART2 Rx Complete
48 USART2_UDRE (CPU) — USART2 Data register Empty
49 USART2_TX (CPU) — USART2 Tx Complete
50 USART2_RXS_START (CPU) — USART2 RX start edge detect
